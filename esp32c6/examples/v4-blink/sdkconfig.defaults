## esp32c6/examples/v4-blink/sdkconfig.defaults
```kconfig
# V4 Blink Example - ESP32-C6 SDK Configuration

# Target configuration
CONFIG_IDF_TARGET="esp32c6"

# Serial console configuration
CONFIG_ESPTOOLPY_BAUD_115200B=y
CONFIG_ESPTOOLPY_BAUD=115200
CONFIG_ESPTOOLPY_MONITOR_BAUD_115200B=y
CONFIG_ESPTOOLPY_MONITOR_BAUD=115200

# USB Serial/JTAG Console (for ESP32-C6)
CONFIG_ESP_CONSOLE_USB_SERIAL_JTAG=y

# FreeRTOS configuration
CONFIG_FREERTOS_HZ=1000

# ESP System configuration
CONFIG_ESP_TASK_WDT_TIMEOUT_S=10

# Compiler options
CONFIG_COMPILER_OPTIMIZATION_SIZE=y
CONFIG_COMPILER_OPTIMIZATION_ASSERTIONS_ENABLE=y

# Log level
CONFIG_LOG_DEFAULT_LEVEL_INFO=y
CONFIG_LOG_MAXIMUM_LEVEL_VERBOSE=y

# Application configuration
CONFIG_ESP_MAIN_TASK_STACK_SIZE=4096
```

## esp32c6/examples/v4-link-demo/sdkconfig.defaults
```kconfig
# ESP32-C6 V4-link Demo Default Configuration

# USB Serial/JTAG for communication
CONFIG_ESP_CONSOLE_USB_SERIAL_JTAG=y
CONFIG_ESP_CONSOLE_SECONDARY_NONE=y

# Main task stack size (8KB for V4 VM)
CONFIG_ESP_MAIN_TASK_STACK_SIZE=8192

# Enable C++ exceptions (required for port implementation)
CONFIG_COMPILER_CXX_EXCEPTIONS=y

# Optimize for size
CONFIG_COMPILER_OPTIMIZATION_SIZE=y

# Log level
CONFIG_LOG_DEFAULT_LEVEL_INFO=y
CONFIG_LOG_MAXIMUM_LEVEL_VERBOSE=y

# UART configuration
CONFIG_UART_ISR_IN_IRAM=y

# FreeRTOS
CONFIG_FREERTOS_HZ=1000

# Memory
CONFIG_ESP_SYSTEM_ALLOW_RTC_FAST_MEM_AS_HEAP=y
```

## esp32c6/examples/v4-repl-demo/sdkconfig.defaults
```kconfig
# V4 REPL Demo - ESP32-C6 SDK Configuration

# Target configuration
CONFIG_IDF_TARGET="esp32c6"

# Serial console configuration
CONFIG_ESPTOOLPY_BAUD_115200B=y
CONFIG_ESPTOOLPY_BAUD=115200
CONFIG_ESPTOOLPY_MONITOR_BAUD_115200B=y
CONFIG_ESPTOOLPY_MONITOR_BAUD=115200

# USB Serial/JTAG Console (for ESP32-C6)
# Enable USB Serial/JTAG but manually manage driver for non-blocking I/O
CONFIG_ESP_CONSOLE_USB_SERIAL_JTAG=y
CONFIG_ESP_CONSOLE_UART_NONE=y

# USB Serial/JTAG secondary console for logging during init
CONFIG_ESP_CONSOLE_SECONDARY_USB_SERIAL_JTAG=y

# FreeRTOS configuration
CONFIG_FREERTOS_HZ=1000

# ESP System configuration
CONFIG_ESP_TASK_WDT_TIMEOUT_S=30
CONFIG_ESP_TASK_WDT_INIT=n
CONFIG_ESP_INT_WDT=n

# Compiler options
CONFIG_COMPILER_OPTIMIZATION_SIZE=y
CONFIG_COMPILER_OPTIMIZATION_ASSERTIONS_ENABLE=y
CONFIG_COMPILER_CXX_EXCEPTIONS=n
CONFIG_COMPILER_CXX_RTTI=n

# Log level
CONFIG_LOG_DEFAULT_LEVEL_INFO=y
CONFIG_LOG_MAXIMUM_LEVEL_INFO=y

# Bootloader log level
CONFIG_BOOTLOADER_LOG_LEVEL_INFO=y
CONFIG_BOOTLOADER_LOG_LEVEL=3

# Application configuration
# Optimized for V4-front with reduced MAX_WORDS/MAX_CONTROL_DEPTH
# Stack usage reduced from 22KB to ~7KB with ESP32-specific settings
CONFIG_ESP_MAIN_TASK_STACK_SIZE=16384

# Increase stack size for REPL
CONFIG_PTHREAD_TASK_STACK_SIZE_DEFAULT=4096
```
